#include <Wire.h>

// 8x8 font, stored outside of class so it can be stored in memery
const uint8_t font8x8[][6] PROGMEM = {
    {0x00,0x00,0x00,0x00,0x00,0x00}, // 0  (null)
    {0x00,0x00,0x00,0x00,0x00,0x00}, // 1
    {0x00,0x00,0x00,0x00,0x00,0x00}, // 2
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    {0x00,0x00,0x00,0x00,0x00,0x00}  // 127 DEL

    /* FONT TEST:
        oled.println("abcdefghijklm");
        oled.println("nopqrstuvwxyz");
        oled.println("ABCDEFGHIJKLM");
        oled.println("NOPQRSTUVWXYZ");
        oled.println("0123456789");
        oled.println(":;!#$%&'()*+,-./");
        oled.println("<=>?@[]^_`{|}~\"\\");
    */
  };

class OLEDIIC_interface {
private:
    uint8_t screenAddress;
    uint8_t screenWidth;
    uint8_t screenHeight;
    uint8_t screenPages;

    uint8_t cursorX = 0;
    uint8_t cursorPage = 0;
    
    // Send I2C command
    void sendCommand(uint8_t cmd) {
        Wire.beginTransmission(screenAddress);
        Wire.write(0x00);
        Wire.write(cmd);
        Wire.endTransmission();
    }

    // Add font character to screen
    void printChar(char character) {
        // Read index from ASCII table
        uint8_t charIndex = character; 
        
        // Turn out of bound characters into spaces 
        if (character < 32 || character > 127) charIndex = 32;  
        
        // If character space, do special handling, else send font data to screen
        if(character==32){sendData(0x00);sendData(0x00);sendData(0x00);sendData(0x00);return;}
        for (uint8_t i = 0; i < 6; i++) {
            uint8_t data = pgm_read_byte(&font8x8[charIndex][i]);
            sendData(data);
        }
    }

public:
    // Screen address and size variables
    OLEDIIC_interface(uint8_t address, uint8_t width, uint8_t height): screenAddress(address), screenWidth(width), screenHeight(height), screenPages(height / 8){}

    // OLED initialization sequence 
    void begin() {
        Wire.begin();

        // Start display off
        sendCommand(0xAE);     

        // Setup clock divide ratio, with a refreash rate of ~100Hz
        sendCommand(0xD5);     
        sendCommand(0x80);     
        
        // Set number of screen lines, 64
        sendCommand(0xA8);     
        sendCommand(0x3F);     
        
        // Set display offset, none
        sendCommand(0xD3);     
        sendCommand(0x00);     
        
        // Set start line to 0
        sendCommand(0x40); 
        
        // Enable capacitor to ensure screen has sificent voltage
        sendCommand(0x8D);     
        sendCommand(0x14);     
        
        // Set memory addressing mode
        sendCommand(0x20);    
        sendCommand(0x00);  
        
        // Set screen orientation 
        sendCommand(0xA1);     
        sendCommand(0xC8);  
        
        // Set default com pin hardware mappings
        sendCommand(0xDA);     
        sendCommand(0x12);     
        
        // Set the contrast to the default
        sendCommand(0x81);    
        sendCommand(0xCF);     
        
        // Pixle charge time, defult, affects brightness and stability
        sendCommand(0xD9);     
        sendCommand(0xF1);    
        
        // Set idial voltage to prevent ghosting, VCOMH deselect level (0.77xVCC)
        sendCommand(0xDB);     
        sendCommand(0x40);     
        
        // Set default RAM usage for graphics
        sendCommand(0xA4);    
        sendCommand(0xA6);    
        
        // Set screen scroll mode
        sendCommand(0x2F);
        
        // Turn on and clear display
        sendCommand(0xAF);     
        clear();
    }

    // Send data to screen
    void sendData(uint8_t data) {
        Wire.beginTransmission(screenAddress);
        Wire.write(0x40);  // Data mode
        Wire.write(data);
        Wire.endTransmission();
    }

    // Set screen to black
    void clear() {
        // Fill entire screen with zeros
        for (uint8_t page = 0; page < screenPages; page++) {
            setCursor(page, 0);
            for (uint8_t col = 0; col < screenWidth; col++) {
                sendData(0x00);
            }
        }
        cursorPage = 0;
        cursorX = 0;
    }

    // Set cursor position on screen
    void setCursor(uint8_t page, uint8_t column) {
        cursorPage = page;
        cursorX = column;
        
        sendCommand(0xB0 + page);                    // Set page
        sendCommand(0x00 + (column & 0x0F));            // Set low column
        sendCommand(0x10 + ((column >> 4) & 0x0F));     // Set high column
    }

    // Handle regular print strings
    void print(const char* str) {
        while (*str) {
            printChar(*str);
            str++;
        }
    }

    // Handle println strings
    void println(const char* str) {
        print(str);
        cursorPage++;
        cursorX = 0;
        if (cursorPage < screenPages) setCursor(cursorPage, 0);
    }

    // Draw single pixle 
    void drawPixel(uint8_t page, uint8_t column, uint8_t pattern) {
        setCursor(page, column);
        sendData(pattern);
    }

    void reset() {
        // Send software reset command sequence
        sendCommand(0xAE);  // Turn off display (some OLEDs use 0xAE)
        delay(10);
        
        // Re-run initialization sequence
        sendCommand(0xAE);  // Display off
        sendCommand(0xD5);  // Set display clock divide
        sendCommand(0x80);
        sendCommand(0xA8);  // Set multiplex
        sendCommand(0x3F);
        sendCommand(0xD3);  // Set display offset
        sendCommand(0x00);
        sendCommand(0x40);  // Set start line
        sendCommand(0x8D);  // Charge pump
        sendCommand(0x14);
        sendCommand(0x20);  // Memory mode
        sendCommand(0x00);
        sendCommand(0xA1);  // Segment remap
        sendCommand(0xC8);  // COM scan direction
        sendCommand(0xDA);  // COM pins
        sendCommand(0x12);
        sendCommand(0x81);  // Contrast
        sendCommand(0x10);
        sendCommand(0xD9);  // Pre-charge
        sendCommand(0x11);
        sendCommand(0xDB);  // VCOM detect
        sendCommand(0x20);
        sendCommand(0xA4);  // Display on resume
        sendCommand(0xA6);  // Normal display
        sendCommand(0x2E);  // Scroll on
        sendCommand(0xAF);  // Display on
        
        clear();  // Clear the display
    }
};

// Initalize I2C class
OLEDIIC_interface screen1(0x3C, 128, 64);

void setup() {
    // Enable I2C, and wait for screen startup
    Wire.begin();
    delay(100);
    
    // Start screen with (I2C address, width, height), reset to defults
    screen1.begin();
    //screen1.reset();
    //screen1.clear();
    screen1.setCursor(0, 0);

    // Add test to screen
    screen1.println("");
    screen1.println("");
    screen1.println("");
    screen1.println("Hello world!");
    screen1.print("This is a test message [TEST]");
}

// Short loading animation
void loop() {
    static uint8_t dots = 5;
    screen1.setCursor(0, 0);
    screen1.print("Screen test");
    for (uint8_t i = 0; i < dots; i++) {
        screen1.print(".");
    }
    screen1.print("       ");
    dots++;
    if (dots > 5) dots = 1;
    delay(250);
}